/include/ "system-conf.dtsi"
/ {
    usb_phy0: phy0@e0002000 {
        compatible = "ulpi-phy";
        #phy-cells = <0>;
        reg = <0xe0002000 0x1000>;
        view-port = <0x0170>;
        drv-vbus;
    };
};

 &usb0 {
    status = "okay";
    dr_mode = "host";
    phy_type = "ulpi";
    usb-phy = <&usb_phy0>;
};

&sdhci0 {
     status = "okay";
     disable-wp;
     broken-cd;
}
